## app/boards/pinnacle_100_dvk.conf
```kconfig
# Modem
CONFIG_MODEM=y
CONFIG_MODEM_HL7800=y
# CONFIG_MODEM_HL7800_SET_APN_NAME_ON_STARTUP=y
# CONFIG_MODEM_HL7800_APN_NAME="internet"
# CONFIG_MODEM_HL7800_CONFIGURE_BANDS=n
# CONFIG_MODEM_HL7800_RECV_BUF_CNT=64
# CONFIG_NET_BUF_RX_COUNT=64

# Modem options
CONFIG_MODEM_HL7800_RAT_M1=y
CONFIG_MODEM_HL7800_LOW_POWER_MODE=y
CONFIG_MODEM_HL7800_BOOT_DELAY=y
CONFIG_MODEM_HL7800_PSM=y
# CONFIG_MODEM_HL7800_PSM_PERIODIC_TAU=
# Active time set to 0 so we can go right to PSM
CONFIG_MODEM_HL7800_PSM_ACTIVE_TIME="00000000"

# modem low power
# CONFIG_MODEM_HL7800_SLEEP_LEVEL_HIBERNATE=y
# CONFIG_MODEM_HL7800_RSSI_RATE_SECONDS=0
# CONFIG_MODEM_HL7800_ALLOW_SLEEP_DELAY_MS=5000

# Segger RTT, requires J-Link RTT Viewer
# CONFIG_UART_CONSOLE=n
# CONFIG_USE_SEGGER_RTT=y
# CONFIG_RTT_CONSOLE=y

# Networking
CONFIG_NET_NATIVE=y
CONFIG_NET_L2_PPP=y
CONFIG_NET_CONTEXT_RCVTIMEO=y
CONFIG_NET_SOCKETS_SOCKOPT_TLS=y
CONFIG_NET_TCP=y
CONFIG_NET_UDP=y


# TLS configuration
CONFIG_SECURE_BOOT=n
CONFIG_MBEDTLS=y
CONFIG_BUILD_WITH_TFM=y
CONFIG_TFM_PROFILE_TYPE_MINIMAL=y
# CONFIG_MBEDTLS_DTLS=y
# CONFIG_MBEDTLS_BUILTIN=y
# CONFIG_NET_SOCKETS_ENABLE_DTLS=y
# CONFIG_NET_SOCKETS_TLS_MAX_CONTEXTS=2
# CONFIG_NRF_SECURITY=y
# CONFIG_MBEDTLS_ENABLE_HEAP=y
# CONFIG_MBEDTLS_HEAP_SIZE=55000

# DNS
CONFIG_DNS_RESOLVER=y
# Allow more time for modem to wakeup
CONFIG_NET_SOCKETS_DNS_TIMEOUT=20000
CONFIG_NET_L2_PPP_OPTION_DNS_USE=y
# CONFIG_DNS_SERVER_IP_ADDRESSES=y
# CONFIG_DNS_SERVER1="1.1.1.1"
# CONFIG_DNS_SERVER2="1.0.0.1"
# CONFIG_DNS_SERVER3="2606:4700:4700::1111"
# CONFIG_DNS_SERVER4="2606:4700:4700::1001"

# External QSPI Flash
CONFIG_NVS=y
CONFIG_NORDIC_QSPI_NOR=y
CONFIG_NORDIC_QSPI_NOR_FLASH_LAYOUT_PAGE_SIZE=4096
CONFIG_NORDIC_QSPI_NOR_STACK_WRITE_BUFFER_SIZE=16
CONFIG_PM_EXTERNAL_FLASH_BASE=0x0
CONFIG_PM_PARTITION_REGION_NVS_STORAGE_EXTERNAL=y
CONFIG_PM_EXTERNAL_FLASH_MCUBOOT_SECONDARY=y

# CONFIG_PM_PARTITION_REGION_LITTLEFS_EXTERNAL=y
# CONFIG_CMU_HFCLK_LFXO=y

# Debugging
CONFIG_MODEM_LOG_LEVEL_DBG=y
CONFIG_NET_TCP_LOG_LEVEL_DBG=y
CONFIG_NET_UDP_LOG_LEVEL_DBG=y
CONFIG_NET_IF_LOG_LEVEL_DBG=y
CONFIG_DNS_RESOLVER_LOG_LEVEL_DBG=y
# CONFIG_MBEDTLS_DEBUG=y
```

## app/child_image/mcuboot/boards/circuitdojo_feather_nrf9160.conf
```kconfig
# SPI Flash
CONFIG_SPI_NOR=y
CONFIG_SPI_NOR_FLASH_LAYOUT_PAGE_SIZE=4096
CONFIG_PM_OVERRIDE_EXTERNAL_DRIVER_CHECK=y

# Speed up flashing
CONFIG_BOOT_ERASE_PROGRESSIVELY=y
```

## build/Kconfig/Kconfig.modules
```kconfig
menu "nrf (/home/jforgue/zephyr-cell-new/nrf)"
osource "/home/jforgue/zephyr-cell-new/nrf/Kconfig.nrf"
config ZEPHYR_NRF_MODULE
	bool
	default y
endmenu
menu "pcf85063a (/home/jforgue/zephyr-cell-new/pcf85063a)"
osource "/home/jforgue/zephyr-cell-new/pcf85063a/Kconfig"
config ZEPHYR_PCF85063A_MODULE
	bool
	default y
endmenu
menu "hostap (/home/jforgue/zephyr-cell-new/modules/lib/hostap)"
osource "/home/jforgue/zephyr-cell-new/modules/lib/hostap/zephyr/Kconfig"
config ZEPHYR_HOSTAP_MODULE
	bool
	default y
endmenu
menu "mcuboot (/home/jforgue/zephyr-cell-new/bootloader/mcuboot)"
osource "$(ZEPHYR_MCUBOOT_KCONFIG)"
config ZEPHYR_MCUBOOT_MODULE
	bool
	default y
endmenu
menu "mbedtls (/home/jforgue/zephyr-cell-new/modules/crypto/mbedtls)"
osource "$(ZEPHYR_MBEDTLS_KCONFIG)"
config ZEPHYR_MBEDTLS_MODULE
	bool
	default y
endmenu
menu "trusted-firmware-m (/home/jforgue/zephyr-cell-new/modules/tee/tf-m/trusted-firmware-m)"
osource "$(ZEPHYR_TRUSTED_FIRMWARE_M_KCONFIG)"
config ZEPHYR_TRUSTED_FIRMWARE_M_MODULE
	bool
	default y
endmenu
menu "azure-sdk-for-c (/home/jforgue/zephyr-cell-new/modules/lib/azure-sdk-for-c)"
osource "$(ZEPHYR_AZURE_SDK_FOR_C_KCONFIG)"
config ZEPHYR_AZURE_SDK_FOR_C_MODULE
	bool
	default y
endmenu
menu "memfault-firmware-sdk (/home/jforgue/zephyr-cell-new/modules/lib/memfault-firmware-sdk)"
osource "/home/jforgue/zephyr-cell-new/modules/lib/memfault-firmware-sdk/ports/zephyr/Kconfig"
config ZEPHYR_MEMFAULT_FIRMWARE_SDK_MODULE
	bool
	default y
endmenu
menu "cirrus-logic (/home/jforgue/zephyr-cell-new/modules/hal/cirrus-logic)"
osource "/home/jforgue/zephyr-cell-new/modules/hal/cirrus-logic/Kconfig"
config ZEPHYR_CIRRUS_LOGIC_MODULE
	bool
	default y
endmenu
menu "canopennode (/home/jforgue/zephyr-cell-new/modules/lib/canopennode)"
osource "$(ZEPHYR_CANOPENNODE_KCONFIG)"
config ZEPHYR_CANOPENNODE_MODULE
	bool
	default y
endmenu
menu "chre (/home/jforgue/zephyr-cell-new/modules/lib/chre)"
osource "/home/jforgue/zephyr-cell-new/modules/lib/chre/platform/zephyr/Kconfig"
config ZEPHYR_CHRE_MODULE
	bool
	default y
endmenu
menu "hal_nordic (/home/jforgue/zephyr-cell-new/modules/hal/nordic)"
osource "$(ZEPHYR_HAL_NORDIC_KCONFIG)"
config ZEPHYR_HAL_NORDIC_MODULE
	bool
	default y
endmenu
menu "liblc3 (/home/jforgue/zephyr-cell-new/modules/lib/liblc3)"
osource "$(ZEPHYR_LIBLC3_KCONFIG)"
config ZEPHYR_LIBLC3_MODULE
	bool
	default y
endmenu
menu "littlefs (/home/jforgue/zephyr-cell-new/modules/fs/littlefs)"
osource "$(ZEPHYR_LITTLEFS_KCONFIG)"
config ZEPHYR_LITTLEFS_MODULE
	bool
	default y
endmenu
menu "nanopb (/home/jforgue/zephyr-cell-new/modules/lib/nanopb)"
osource "$(ZEPHYR_NANOPB_KCONFIG)"
config ZEPHYR_NANOPB_MODULE
	bool
	default y
endmenu
menu "picolibc (/home/jforgue/zephyr-cell-new/modules/lib/picolibc)"
osource "/home/jforgue/zephyr-cell-new/modules/lib/picolibc/zephyr/Kconfig"
config ZEPHYR_PICOLIBC_MODULE
	bool
	default y
endmenu
menu "TraceRecorder (/home/jforgue/zephyr-cell-new/modules/debug/TraceRecorder)"
osource "/home/jforgue/zephyr-cell-new/modules/debug/TraceRecorder/kernelports/Zephyr/Kconfig"
config ZEPHYR_TRACERECORDER_MODULE
	bool
	default y
endmenu
menu "uoscore-uedhoc (/home/jforgue/zephyr-cell-new/modules/lib/uoscore-uedhoc)"
osource "$(ZEPHYR_UOSCORE_UEDHOC_KCONFIG)"
config ZEPHYR_UOSCORE_UEDHOC_MODULE
	bool
	default y
endmenu
menu "zcbor (/home/jforgue/zephyr-cell-new/modules/lib/zcbor)"
osource "$(ZEPHYR_ZCBOR_KCONFIG)"
config ZEPHYR_ZCBOR_MODULE
	bool
	default y
endmenu
menu "zscilib (/home/jforgue/zephyr-cell-new/modules/lib/zscilib)"
osource "/home/jforgue/zephyr-cell-new/modules/lib/zscilib/Kconfig.zscilib"
config ZEPHYR_ZSCILIB_MODULE
	bool
	default y
endmenu
menu "nrfxlib (/home/jforgue/zephyr-cell-new/nrfxlib)"
osource "/home/jforgue/zephyr-cell-new/nrfxlib/Kconfig.nrfxlib"
config ZEPHYR_NRFXLIB_MODULE
	bool
	default y
endmenu
```
